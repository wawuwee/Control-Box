## boards/shields/gs_control_box/Kconfig.defconfig
```kconfig
if SHIELD_GS_CONTROL_BOX

config ZMK_KEYBOARD_NAME
    default "GS Control Box"

endif
```

## config/boards/shields/gs_control_box/Kconfig.shield
```kconfig
config SHIELD_GS_CONTROL_BOX
    def_bool $(shields_list_contains,gs_control_box)
```
